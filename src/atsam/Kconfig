## src/atsam/Kconfig
```kconfig
# Kconfig settings for Atmel SAM processors

if MACH_ATSAM

config ATSAM_SELECT
    bool
    default y
    select HAVE_GPIO
    select HAVE_GPIO_ADC
    select HAVE_GPIO_I2C
    select HAVE_GPIO_SPI
    select HAVE_GPIO_HARD_PWM
    select HAVE_GPIO_BITBANGING

config BOARD_DIRECTORY
    string
    default "atsam"

choice
    prompt "Processor model"
    config MACH_SAM3X8E
        bool "SAM3x8e (Arduino Due)"
        select MACH_SAM3X
    config MACH_SAM3X8C
        bool "SAM3x8c (Printrboard G2)"
        select MACH_SAM3X
    config MACH_SAM4S8C
        bool "SAM4s8c (Duet Maestro)"
        select MACH_SAM4S
    config MACH_SAM4E8E
        bool "SAM4e8e (Duet Wifi/Eth)"
        select MACH_SAM4E
endchoice

config MACH_SAM3X
    bool
config MACH_SAM4
    bool
config MACH_SAM4S
    bool
    select MACH_SAM4
config MACH_SAM4E
    bool
    select MACH_SAM4

config MCU
    string
    default "sam3x8e" if MACH_SAM3X8E
    default "sam3x8c" if MACH_SAM3X8C
    default "sam4s8c" if MACH_SAM4S8C
    default "sam4e8e" if MACH_SAM4E8E

choice
    depends on MACH_SAM3X && LOW_LEVEL_OPTIONS
    prompt "Processor speed"
    config SAM3X_FREQ_84
        bool "84 MHz (standard)"
    config SAM3X_FREQ_96
        bool "96 MHz (overclock)"
    config SAM3X_FREQ_108
        bool "108 MHz (overclock)"
endchoice

config CLOCK_FREQ
    int
    default 108000000 if SAM3X_FREQ_108
    default 96000000 if SAM3X_FREQ_96
    default 84000000 if MACH_SAM3X
    default 120000000 if MACH_SAM4

config FLASH_START
    hex
    default 0x400000 if MACH_SAM4
    default 0x80000

config FLASH_SIZE
    hex
    default 0x80000

config RAM_START
    hex
    default 0x20000000

config RAM_SIZE
    hex
    default 0x18000 if MACH_SAM3X
    default 0x20000 if MACH_SAM4

config STACK_SIZE
    int
    default 512

config USBSERIAL
    bool "Use USB for communication (instead of serial)"
    default y
config SERIAL
    depends on !USBSERIAL
    bool
    default y

config RPI_SERIAL
    depends on !USBSERIAL
    bool "Use RPi GPIO serial"
    default n
config RPI_RESET_PIN
    depends on RPI_SERIAL
    int "Reset RPi GPIO pin (BCM)"
    default 22
config RPI_ERASE_PIN
    depends on RPI_SERIAL
    int "Erase RPi GPIO pin (BCM)"
    default 8

config BOARD_OULWARE
    depends on MACH_SAM3X8E
    bool "OULWare PrinterController v1.5 or newer"
    default n

config INITIAL_PINS
    string
    default "!PC14" if BOARD_OULWARE
    default ""

endif
```

## src/esp32/Kconfig
```kconfig
# Kconfig settings for Atmel SAM processors

if MACH_ESP32

config ESP32_SELECT
    bool
    default y
    select HAVE_GPIO
    select HAVE_GPIO_ADC
#    select HAVE_GPIO_I2C
    select HAVE_GPIO_SPI
    select HAVE_GPIO_BITBANGING

config BOARD_DIRECTORY
    string
    default "esp32"

config MCU
    string
    default "esp32"

config CLOCK_FREQ
    int
    default 40000000 # 80000000/2

############### UART SETTINGS ##################
choice
    prompt "UART number"
    #depends on SERIAL_UART
    config SERIAL_UART0_USED
        bool "UART0 (RX=GPIO3, TX=GPIO1)"
    config SERIAL_UART1_USED
        bool "UART1 (RX=GPIO9, TX=GPI10)"
    config SERIAL_UART2_USED
        bool "UART2 (RX=GPI16, TX=GPI17)"
    config SERIAL_CUSTOM_USED
        bool "Custom UART pins"
    config SERIAL_BT
        bool "Bluetooth Serial"
endchoice

config SERIAL_CUSTOM_RXD
    int "UART Custom RXD pin"
    depends on SERIAL_CUSTOM_USED
    default 3
config SERIAL_CUSTOM_TXD
    int "UART Custom TXD pin"
    depends on SERIAL_CUSTOM_USED
    default 1

config SERIAL_UART
    bool
    default y if !SERIAL_BT
    default n if SERIAL_BT

config SERIAL
    depends on !SERIAL_BT
    bool
    default y

############### BLUETOOTH SETTINGS ##################
config SERIAL_BT_NAME
    string "Bluetooth name"
    depends on SERIAL_BT
    default "KLIPPER_BT"

config SERIAL_BT_PIN
    string "Bluetooth pin code"
    depends on SERIAL_BT
    default "1234"

############### SPI SETTINGS ##################


############### TARGET MODULE ##################
choice
    prompt "Target hardware"
    config TMC5130
        bool "Motor Controller (TMC5130)"
    config TMC5160
        bool "Motor Controller (TMC5160)"
    config HOTENDCTRL
        bool "Hotend Controller (Carriage)"
    config STACK_HOTEND
        bool "RPi Hotend Module (stack)"
    config STACK_MOTOR
        bool "RPi Motor Module (stack)"
endchoice


############### IO EXPANDER SETTINGS ##################
config KLIPPER_HAS_IO_EXPANDERS
    default n if !(STACK_HOTEND || STACK_MOTOR)
    default y if (STACK_HOTEND || STACK_MOTOR)

config KLIPPER_HAS_IO_EXPANDERS
    bool "Has IO Expanders (MCP23S17)"
    depends on (STACK_HOTEND || STACK_MOTOR)

config KLIPPER_CUSTOM_IO_EXPANDERS
    bool "Custom IO expander config (MCP23S17)"
    depends on KLIPPER_HAS_IO_EXPANDERS
    default n

choice
    prompt "Number of IO Expanders"
    depends on KLIPPER_CUSTOM_IO_EXPANDERS
    default KLIPPER_IO_EXPANDERS_CNT_2
    config KLIPPER_IO_EXPANDERS_CNT_1
        bool "1"
    config KLIPPER_IO_EXPANDERS_CNT_2
        bool "2"
    config KLIPPER_IO_EXPANDERS_CNT_3
        bool "3"
endchoice

# Init values
config KLIPPER_IO_EXPANDER_0_CS
    default -1 if !(STACK_HOTEND || STACK_MOTOR)
    default 23 if STACK_MOTOR
    default 22 if STACK_HOTEND
config KLIPPER_IO_EXPANDER_1_CS
    default -1 if !STACK_MOTOR
    default 22 if STACK_MOTOR
config KLIPPER_IO_EXPANDER_2_CS
    default -1
config KLIPPER_IO_EXPANDER_BUS
    default -1 if !(STACK_HOTEND || STACK_MOTOR)
    default 1 if (STACK_HOTEND || STACK_MOTOR)
config KLIPPER_IO_EXPANDER_MODE
    default -1 if !(STACK_HOTEND || STACK_MOTOR)
    default 0 if (STACK_HOTEND || STACK_MOTOR)
config KLIPPER_IO_EXPANDER_SPEED
    default 0 if !(STACK_HOTEND || STACK_MOTOR)
    default 4000000 if (STACK_HOTEND || STACK_MOTOR)

# user config
config KLIPPER_IO_EXPANDER_0_CS
    int "CS pin 1"
    depends on KLIPPER_CUSTOM_IO_EXPANDERS && (KLIPPER_IO_EXPANDERS_CNT_1 || KLIPPER_IO_EXPANDERS_CNT_2 || KLIPPER_IO_EXPANDERS_CNT_3)
    default -1 if !(STACK_HOTEND || STACK_MOTOR)
    default 23 if STACK_MOTOR
    default 22 if STACK_HOTEND

config KLIPPER_IO_EXPANDER_1_CS
    int "CS pin 2"
    depends on KLIPPER_CUSTOM_IO_EXPANDERS && (KLIPPER_IO_EXPANDERS_CNT_2 || KLIPPER_IO_EXPANDERS_CNT_3)
    default -1 if !STACK_MOTOR
    default 22 if STACK_MOTOR

config KLIPPER_IO_EXPANDER_2_CS
    int "CS pin 3"
    depends on KLIPPER_CUSTOM_IO_EXPANDERS && KLIPPER_IO_EXPANDERS_CNT_3
    default -1

config KLIPPER_IO_EXPANDER_BUS
    int "SPI Bus index"
    depends on KLIPPER_CUSTOM_IO_EXPANDERS && (KLIPPER_IO_EXPANDERS_CNT_1 || KLIPPER_IO_EXPANDERS_CNT_2 || KLIPPER_IO_EXPANDERS_CNT_3)
    default -1 if !(STACK_HOTEND || STACK_MOTOR)
    default 1 if (STACK_HOTEND || STACK_MOTOR)

config KLIPPER_IO_EXPANDER_MODE
    int "SPI Mode"
    depends on KLIPPER_CUSTOM_IO_EXPANDERS && (KLIPPER_IO_EXPANDERS_CNT_1 || KLIPPER_IO_EXPANDERS_CNT_2 || KLIPPER_IO_EXPANDERS_CNT_3)
    default -1 if !(STACK_HOTEND || STACK_MOTOR)
    default 1 if (STACK_HOTEND || STACK_MOTOR)

config KLIPPER_IO_EXPANDER_SPEED
    int "SPI Speed"
    depends on KLIPPER_CUSTOM_IO_EXPANDERS && (KLIPPER_IO_EXPANDERS_CNT_1 || KLIPPER_IO_EXPANDERS_CNT_2 || KLIPPER_IO_EXPANDERS_CNT_3)
    default 0 if !(STACK_HOTEND || STACK_MOTOR)
    default 4000000 if (STACK_HOTEND || STACK_MOTOR)

endif
```

## src/linux/Kconfig
```kconfig
# Kconfig settings for compiling and running the micro-controller code
# in a Linux process

if MACH_LINUX

config LINUX_SELECT
    bool
    default y
    select HAVE_GPIO
    select HAVE_GPIO_ADC
    select HAVE_GPIO_SPI
    select HAVE_GPIO_BITBANGING if SIMULATOR

config BOARD_DIRECTORY
    string
    default "linux"

config CLOCK_FREQ
    int
    default 8000000 if SIM_MACH_atmega2560_8
    default 20000000 if !SIM_MACH_atmega2560_8

config SIMULATOR
    bool "Compile for target software simulator"
    default n
    help
        Compile the target simulator code. Simulated
        results are sent back to host.

choice
    prompt "Simulated processor model"
    depends on SIMULATOR
    config SIM_MACH_atmega2560
        bool "atmega2560"
    config SIM_MACH_atmega2560_8
        bool "atmega2560 8MHz"
    config SIM_MACH_sam3x8e
        bool "sam3x8e"
    config SIM_MACH_lpc176x
        bool "lpc176x"
    config SIM_MACH_esp32
        bool "esp32"
endchoice

config MCU
    string
    depends on SIMULATOR
    default "linux" if !SIMULATOR
    default "atmega2560" if SIMULATOR && (SIM_MACH_atmega2560 || SIM_MACH_atmega2560_8)
    default "sam3x8e" if SIMULATOR && SIM_MACH_sam3x8e
    default "lpc176x" if SIMULATOR && SIM_MACH_lpc176x
    default "esp32" if SIMULATOR && SIM_MACH_esp32

config ADC_MAX_VALUE
    int
    default 4095 if !SIMULATOR
    default 4095 if SIMULATOR && (SIM_MACH_sam3x8e || SIM_MACH_lpc176x || SIM_MACH_esp32)
    default 1023 if SIMULATOR && (SIM_MACH_atmega2560 || SIM_MACH_atmega2560_8)

endif
```

## src/lpc176x/Kconfig
```kconfig
# Kconfig settings for SAM3x8e processors

if MACH_LPC176X

config LPC_SELECT
    bool
    default y
    select HAVE_GPIO
    select HAVE_GPIO_ADC
    select HAVE_GPIO_SPI

config BOARD_DIRECTORY
    string
    default "lpc176x"

config CLOCK_FREQ
    int
    default 30000000 # 120000000/4

config SERIAL
    bool
    default y

config SERIAL_BAUD
    depends on SERIAL
    int "Baud rate for serial port"
    default 250000

endif
```

## src/sam3x8e/Kconfig
```kconfig
# Kconfig settings for SAM3x8e processors

if MACH_SAM3X8E

config SAM_SELECT
    bool
    default y
    select HAVE_GPIO
    select HAVE_GPIO_ADC
    select HAVE_GPIO_SPI
    select HAVE_GPIO_BITBANGING

config BOARD_DIRECTORY
    string
    default "sam3x8e"

config CLOCK_FREQ
    int
    default 42000000 # 84000000/2

config SERIAL
    bool
    default y
config SERIAL_BAUD
    depends on SERIAL
    int "Baud rate for serial port"
    default 250000

config RPI_SERIAL
    bool "Use RPi serial instead of USB"
    default n
config RPI_RESET_PIN
    depends on RPI_SERIAL
    int "Reset RPi GPIO pin (BCM)"
    default 22
config RPI_ERASE_PIN
    depends on RPI_SERIAL
    int "Erase RPi GPIO pin (BCM)"
    default 8

endif
```
